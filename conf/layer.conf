## conf/layer.conf
```bitbake
# We have a conf and classes directory, add to BBPATH
BBPATH .= ":${LAYERDIR}"

# We have a packages directory, add to BBFILES
BBFILES += "${LAYERDIR}/recipes-*/*/*.bb \
            ${LAYERDIR}/recipes-*/*/*.bbappend"

BBFILE_COLLECTIONS += "openfiles-layer"
BBFILE_PATTERN_openfiles-layer := "^${LAYERDIR}/"
BBFILE_PRIORITY_openfiles-layer = "5"

# This should only be incremented on significant changes that will
# cause compatibility issues with other layers
LAYERVERSION_networking-layer = "1"

LAYERDEPENDS_openfiles-layer = "core"
LAYERDEPENDS_openfiles-layer += "openembedded-layer"
LAYERDEPENDS_openfiles-layer += "networking-layer"

LICENSE_PATH += "${LAYERDIR}/licenses"


LAYERSERIES_COMPAT_openfiles-layer = "hardknott pyro"
```
